## Firmware/build/Kconfig/arch/Kconfig
```kconfig
# Load Zephyr Arch Kconfig descriptions.
osource "/home/rafael/zephyrproject/zephyr/arch/rx/Kconfig"
osource "/home/rafael/zephyrproject/zephyr/arch/x86/Kconfig"
osource "/home/rafael/zephyrproject/zephyr/arch/xtensa/Kconfig"
osource "/home/rafael/zephyrproject/zephyr/arch/sparc/Kconfig"
osource "/home/rafael/zephyrproject/zephyr/arch/riscv/Kconfig"
osource "/home/rafael/zephyrproject/zephyr/arch/posix/Kconfig"
osource "/home/rafael/zephyrproject/zephyr/arch/mips/Kconfig"
osource "/home/rafael/zephyrproject/zephyr/arch/arm64/Kconfig"
osource "/home/rafael/zephyrproject/zephyr/arch/arm/Kconfig"
osource "/home/rafael/zephyrproject/zephyr/arch/arc/Kconfig"
```

## Firmware/build/Kconfig/boards/Kconfig.defconfig
```kconfig
# Load Zephyr board defconfig descriptions.
osource "/home/rafael/zephyrproject/zephyr/boards/seeed/xiao_ble/Kconfig.defconfig"
```

## Firmware/build/Kconfig/boards/Kconfig.sysbuild
```kconfig
# Load Sysbuild board Kconfig descriptions.
osource "/home/rafael/zephyrproject/zephyr/boards/seeed/xiao_ble/Kconfig.sysbuild"
```

## Firmware/build/Kconfig/boards/Kconfig.xiao_ble
```kconfig
# Load board Kconfig descriptions.
osource "/home/rafael/zephyrproject/zephyr/boards/seeed/xiao_ble/Kconfig.xiao_ble"
```
